/dts-v1/;
/plugin/;

/ {
    compatible = "friendlyelec,nanopi-neo3", "rockchip,rk3328";

    fragment@0 {
        target = <&spdif_out>;
        __overlay__ {
        status = "okay";
        };
    };
};